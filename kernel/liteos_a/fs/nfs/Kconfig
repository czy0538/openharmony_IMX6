## kernel/liteos_a/fs/nfs/Kconfig
```kconfig
config FS_NFS
    bool "Enable NFS"
    default y
    depends on FS_VFS
    depends on NET_LWIP_SACK
    help
      Answer Y to enable LiteOS support nfs filesystem.

menu "Lib"
config LIB_LIBC
    bool "Enable Libc"
    default y
    help
      Answer Y to enable libc for full code.

config LIB_ZLIB
    bool "Enable Zlib"
    default y
    depends on LIB_LIBC
    help
      Answer Y to enable LiteOS support compress file library.
endmenu
```

## kernel/liteos_a/platform/Kconfig
```kconfig
config PLATFORM
    string
    default "hi3516dv300"     if PLATFORM_HI3516DV300
    default "hi3518ev300"     if PLATFORM_HI3518EV300
    default "imx6ull"         if PLATFORM_IMX6ULL
    default "stm32mp157"      if PLATFORM_STM32MP157 
    default "demochip"        if PLATFORM_DEMOCHIP

choice
    prompt "Board"
    default PLATFORM_HI3516DV300
    help
      IPC has several chips:
      hi3516dv300
      hi3518ev300

config PLATFORM_HI3516DV300
    bool "hi3516dv300"
    select ARCH_CORTEX_A7

config PLATFORM_HI3518EV300
    bool "hi3518ev300"
    select ARCH_CORTEX_A7

config PLATFORM_STM32MP157
    bool "stm32mp157"
    select ARCH_CORTEX_A7

config PLATFORM_IMX6ULL
    bool "imx6ull"
    select ARCH_CORTEX_A7

config PLATFORM_DEMOCHIP
    bool "demochip"
    select ARCH_CORTEX_A7

endchoice

config TEE_ENABLE
    bool "ENABLE TEE"
    default n
    depends on PLATFORM_HI3516DV300
    help
        ENABLE teeos in platform

choice
    prompt "IRQCHIP"
    default PLATFORM_BSP_GIC_V2
    help
      Interrupt Controller.

config PLATFORM_BSP_GIC_V2
    bool "GIC Version 2"
    help
      This GIC(General Interrupt Controller) version 2 driver is compatatble with
      GIC version 1 and version 2.

config PLATFORM_BSP_GIC_V3
    bool "GIC Version 3"
    depends on ARCH_ARM_V8A || ARCH_ARM_V8R
    help
      General Interrupt Controller version 3.

endchoice
```
